/*
 * Keymap stellar, loosly based on:
 *   https://github.com/urob/zmk-config/blob/main/config/base.keymap
 */


#include <behaviors.dtsi>
#include <behaviors/num_word.dtsi> // requires auto-layer module
#include <dt-bindings/zmk/keys.h>

#ifdef CONFIG_WIRELESS
    #include <dt-bindings/zmk/bt.h>
    #define _BT_SEL_KEYS_ &bt BT_SEL 0 &bt BT_SEL 1 &bt BT_SEL 2 &bt BT_SEL 3 &bt BT_CLR
#else
    #define _BT_SEL_KEYS_ &trans &trans &trans &trans &trans
#endif

#ifdef CONFIG_RGB_UNDERGLOW
    #include <dt-bindings/zmk/rgb.h>
    #define UG_CLR_PINK &rgb_ug RGB_COLOR_HSB(328, 100, 54)
    #define UG_CLR_RED  &rgb_ug RGB_COLOR_HSB(348, 83, 47)
    #define UG_CLR_BLUE &rgb_ug RGB_COLOR_HSB(207, 44, 49)
    #define UG_CLR_PRPL &rgb_ug RGB_COLOR_HSB(260, 49, 86)

    #define _UG_RGB_CLR_KEYS_ &rgb_ug RGB_TOG UG_CLR_PINK UG_CLR_RED UG_CLR_BLUE UG_CLR_PRPL
    #define _UG_RGB_UP_KEYS_ &rgb_ug RGB_HUI &rgb_ug RGB_SAI &rgb_ug RGB_BRI &rgb_ug RGB_SPI &rgb_ug RGB_EFF
    #define _UG_RGB_DN_KEYS_ &rgb_ug RGB_HUD &rgb_ug RGB_SAD &rgb_ug RGB_BRD &rgb_ug RGB_SPD &rgb_ug RGB_EFR
#else
    #define _UG_RGB_CLR_KEYS_ &trans &trans &trans &trans &trans
    #define _UG_RGB_UP_KEYS_ &trans &trans &trans &trans &trans
    #define _UG_RGB_DN_KEYS_ &trans &trans &trans &trans &trans
#endif

#include "zmk-helpers/helper.h"

#define DEF  0
#define SYM  1
#define NAV  2
#define FN   3
#define SYS  4
#define MED  5
#define GAM  6
#define GAMP 7

#define XXX &none
#define ___ &trans


/* Global settings */

#define QUICK_TAP_MS 175

&sk {  // sticky-key config
    release-after-ms = <900>;  // release after 0.9s
    quick-release;             // no double capitalization when rolling keys
};

&sl {  // sticky-layer config
    ignore-modifiers;          // allow chording sticky mods & layers
};

&lt {  // layer-tap config
    flavor = "balanced";
    tapping-term-ms = <200>;
    quick-tap-ms = <QUICK_TAP_MS>;
};


/* Homerow mods */

#define KEYS_L LT0 LT1 LT2 LT3 LT4 LM0 LM1 LM2 LM3 LM4 LB0 LB1 LB2 LB3 LB4  // left hand
#define KEYS_R RT0 RT1 RT2 RT3 RT4 RM0 RM1 RM2 RM3 RM4 RB0 RB1 RB2 RB3 RB4  // right hand
#define THUMBS LH3 LH2 LH1 LH0 RH0 RH1 RH2 RH3                              // thumbs

#define MAKE_HRM(NAME, HOLD, TAP, TRIGGER_POS) \
    ZMK_HOLD_TAP(NAME, \
        flavor = "balanced"; \
        tapping-term-ms = <280>; \
        quick-tap-ms = <QUICK_TAP_MS>; \
        require-prior-idle-ms = <150>; \
        bindings = <HOLD>, <TAP>; \
        hold-trigger-key-positions = <TRIGGER_POS>; \
        hold-trigger-on-release; \
    )
MAKE_HRM(hml, &kp, &kp, KEYS_R THUMBS)  // left-hand HRMs
MAKE_HRM(hmr, &kp, &kp, KEYS_L THUMBS)  // right-hand HRMs


/* Combos, leader key sequences */

#include "combos.dtsi"  // must be sources after HRM-combo hack


/* Nav cluster */

// long-tap action on hold, short-tap action on all interrupts
#define MT_CORE \
    flavor = "tap-preferred"; \
    tapping-term-ms = <220>; \
    quick-tap-ms = <220>; \
    hold-trigger-key-positions = <0>;

&mt { MT_CORE };
ZMK_HOLD_TAP(mt_home, bindings = <&masked_home>, <&kp>; MT_CORE)
ZMK_HOLD_TAP(mt_end, bindings = <&masked_end>, <&kp>; MT_CORE)

#define NAV_LEFT  &mt_home 0   LEFT    // tap: left  | long-tap: beginning of line
#define NAV_RIGHT &mt_end 0    RIGHT   // tap: right | long-tap: end       of line
#define NAV_UP    &mt LC(HOME) UP      // tap: up    | long-tap: beginning of document
#define NAV_DOWN  &mt LC(END)  DOWN    // tap: down  | long-tap: end       of document

// mask CTRL when holding left/right to avoid accidental jumps to beginning/end of document
#define MASK_MODS(NAME, MODS, BINDING) \
    ZMK_MOD_MORPH(NAME, \
        bindings = <BINDING>, <BINDING>; \
        mods = <MODS>; \
    )
MASK_MODS(masked_home, (MOD_LCTL), &kp HOME)
MASK_MODS(masked_end,  (MOD_LCTL), &kp END)


/* Caps-word, num-word */

// tap: sticky-shift | shift + tap/ double-tap: caps-word | hold: shift
ZMK_MOD_MORPH(smart_shft,
    bindings = <&sk LSHFT>, <&caps_word>;
    mods = <(MOD_LSFT)>;
)
&caps_word {  // mods deactivate caps-word, requires PR #1451
    /delete-property/ ignore-modifiers;
};

// tap: num-word | double-tap: sticky num-layer | hold: num-layer
#define SMART_NUM &smart_num SYM 0
ZMK_HOLD_TAP(smart_num,
    flavor = "balanced";
    tapping-term-ms = <200>;
    quick-tap-ms = <QUICK_TAP_MS>;
    bindings = <&mo>, <&num_dance>;
)
ZMK_TAP_DANCE(num_dance,
    tapping-term-ms = <200>;
    bindings = <&num_word SYM>, <&sl SYM>;  // reverse this for sticky-num on single tap
)


/* Custom behaviors */

// reuse basic mod-morph scheme
#define SIMPLE_MORPH(NAME, MOD, BINDING1, BINDING2) \
    ZMK_MOD_MORPH(NAME, \
        mods = <(MOD_L ## MOD|MOD_R ## MOD)>; \
        bindings = <BINDING1>, <BINDING2>; \
    )

// tap: space | shift + tap: dot -> space -> sticky shift | hold: activate layer
ZMK_HOLD_TAP(lt_spc,
    flavor = "balanced";
    tapping-term-ms = <200>;
    quick-tap-ms = <QUICK_TAP_MS>;
    bindings = <&mo>, <&spc_morph>;
)
SIMPLE_MORPH(spc_morph, SFT, &kp SPACE, &dot_spc)
ZMK_MACRO(dot_spc,
    wait-ms = <0>;
    tap-ms = <5>;
    bindings = <&kp DOT &kp SPACE &sk LSHFT>;
)

// tap: backspace | lshft + tap: delete | rshft + tap: shift-delete
ZMK_MOD_MORPH(bs_del,
    bindings = <&kp BSPC>, <&kp DEL>;
    mods = <(MOD_LSFT|MOD_RSFT)>;
    keep-mods = <MOD_RSFT>;
)

// tap: copy | double-tap: cut
ZMK_TAP_DANCE(copy_cut,
    tapping-term-ms = <200>;
    bindings = <&kp LC(INS)>, <&kp LC(X)>;
)

// misc aliases
#define CANCEL      &kp K_CANCEL             // cancel caps-word, num-word and smart-mouse

#define KP_MIN      KP_MINUS
#define KP_MUL      KP_MULTIPLY
#define KP_DIV      KP_DIVIDE


/* Keymap */

ZMK_CONDITIONAL_LAYER(sys, FN SYM, SYS)  // FN + NUM --> SYS

ZMK_LAYER(base,
//            ╭─────────────┬─────────────┬─────────────┬─────────────┬─────────────╮  ╭─────────────┬─────────────┬─────────────┬─────────────┬─────────────╮
                &kp N1        &kp N2        &kp N3        &kp N4        &kp N5           &kp N6        &kp N7        &kp N8        &kp N9        &kp N0
//            ├─────────────┼─────────────┼─────────────┼─────────────┼─────────────┤  ├─────────────┼─────────────┼─────────────┼─────────────┼─────────────┤
                &kp Q         &kp W         &kp F         &kp P         &kp B            &kp J         &kp L         &kp U         &kp Y         &kp SEMI
//╭─────────╮ ├─────────────┼─────────────┼─────────────┼─────────────┼─────────────┤  ├─────────────┼─────────────┼─────────────┼─────────────┼─────────────┤ ╭─────────╮
    &kp ESC     &hml LGUI A   &hml LALT R   &hml LSHFT S  &hml LCTRL T  &kp G            &kp M         &hmr LCTRL N  &hmr LSHFT E  &hmr LALT I   &hmr LGUI O     &kp RET
//╰─────────╯ ├─────────────┼─────────────┼─────────────┼─────────────┼─────────────┤  ├─────────────┼─────────────┼─────────────┼─────────────┼─────────────┤ ╰─────────╯
                &kp Z         &kp X         &kp C         &kp D         &kp V            &kp K         &kp H         &kp COMMA     &kp DOT       &kp FSLH
//            ╰─────────────┼─────────────┼─────────────┼─────────────┼─────────────┤  ├─────────────┼─────────────┼─────────────┴───────────────────────────╯
                              &lt_spc NAV 0 &smart_shft   &lt FN TAB    &mo MED          &kp RET       &kp DEL       &kp BSPC      SMART_NUM
//                          ╰─────────────┴─────────────┴─────────────┴─────────────╯  ╰─────────────┴─────────────┴─────────────┴─────────────╯
)


ZMK_LAYER(sym,
//            ╭─────────────┬─────────────┬─────────────┬─────────────┬─────────────╮  ╭─────────────┬─────────────┬─────────────┬─────────────┬─────────────╮
                ___           ___           ___           ___           ___              ___           ___           ___           ___           ___
//            ├─────────────┼─────────────┼─────────────┼─────────────┼─────────────┤  ├─────────────┼─────────────┼─────────────┼─────────────┼─────────────┤
                &kp KP_PLUS   &kp N7        &kp N8        &kp N9        &kp LBKT         &kp RBKT      &kp GRAVE     &kp MINUS     &kp TILDE     &kp AMPS
//╭─────────╮ ├─────────────┼─────────────┼─────────────┼─────────────┼─────────────┤  ├─────────────┼─────────────┼─────────────┼─────────────┼─────────────┤ ╭─────────╮
    ___         &kp N0        &kp N4        &kp N5        &kp N6        &kp LBRC         &kp RBRC      &kp DQT       &kp UNDER     &kp EQUAL     &kp PIPE        ___
//╰─────────╯ ├─────────────┼─────────────┼─────────────┼─────────────┼─────────────┤  ├─────────────┼─────────────┼─────────────┼─────────────┼─────────────┤ ╰─────────╯
                &kp KP_MIN    &kp N1        &kp N2        &kp N3        &kp LPAR         &kp RPAR      &kp APOS      &kp PLUS      &kp STAR      &kp BSLH
//            ╰─────────────┼─────────────┼─────────────┼─────────────┼─────────────┤  ├─────────────┼─────────────┼─────────────┴───────────────────────────╯
                              &kp DOT       &kp KP_MUL    &kp KP_DIV    ___              ___           ___           ___           CANCEL
//                          ╰─────────────┴─────────────┴─────────────┴─────────────╯  ╰─────────────┴─────────────┴─────────────┴─────────────╯
)


ZMK_LAYER(nav,
//            ╭─────────────┬─────────────┬─────────────┬─────────────┬─────────────╮  ╭─────────────┬─────────────┬─────────────┬─────────────┬─────────────╮
                ___           ___           ___           ___           ___              ___           ___           ___           ___           ___
//            ├─────────────┼─────────────┼─────────────┼─────────────┼─────────────┤  ├─────────────┼─────────────┼─────────────┼─────────────┼─────────────┤
                ___           ___           ___           ___           ___              ___           &kp END       &kp HOME      ___           ___
//╭─────────╮ ├─────────────┼─────────────┼─────────────┼─────────────┼─────────────┤  ├─────────────┼─────────────┼─────────────┼─────────────┼─────────────┤ ╭─────────╮
    ___         ___           ___           ___           ___           ___              NAV_LEFT      NAV_DOWN      NAV_UP        NAV_RIGHT     &kp INS         ___
//╰─────────╯ ├─────────────┼─────────────┼─────────────┼─────────────┼─────────────┤  ├─────────────┼─────────────┼─────────────┼─────────────┼─────────────┤ ╰─────────╯
                ___           ___           ___           ___           ___              ___           &kp PG_DN     &kp PG_UP     ___           &kp DEL
//            ╰─────────────┼─────────────┼─────────────┼─────────────┼─────────────┤  ├─────────────┼─────────────┼─────────────┴───────────────────────────╯
                              ___           ___           ___           ___              ___           ___           ___           ___
//                          ╰─────────────┴─────────────┴─────────────┴─────────────╯  ╰─────────────┴─────────────┴─────────────┴─────────────╯
)


ZMK_LAYER(fn,
//            ╭─────────────┬─────────────┬─────────────┬─────────────┬─────────────╮  ╭─────────────┬─────────────┬─────────────┬─────────────┬─────────────╮
                &kp F1        &kp F2        &kp F3        &kp F4        &kp F5           &kp F6        &kp F7        &kp F8        &kp F9        &kp F10
//            ├─────────────┼─────────────┼─────────────┼─────────────┼─────────────┤  ├─────────────┼─────────────┼─────────────┼─────────────┼─────────────┤
                &kp F11       &kp F12       &kp F13       &kp F14       &kp F15          &kp F16       &kp F17       &kp F18       &kp F19       &kp F20
//╭─────────╮ ├─────────────┼─────────────┼─────────────┼─────────────┼─────────────┤  ├─────────────┼─────────────┼─────────────┼─────────────┼─────────────┤ ╭─────────╮
   &kp PSCRN    ___           ___           ___           &kp SLCK      &kp PAUSE_BREAK  ___           ___           ___           ___           ___             ___
//╰─────────╯ ├─────────────┼─────────────┼─────────────┼─────────────┼─────────────┤  ├─────────────┼─────────────┼─────────────┼─────────────┼─────────────┤ ╰─────────╯
                ___           ___           ___           &kp CLCK      &kp SYSREQ       ___           ___           ___           ___           ___
//            ╰─────────────┼─────────────┼─────────────┼─────────────┼─────────────┤  ├─────────────┼─────────────┼─────────────┴───────────────────────────╯
                              ___           ___           ___           ___              ___           ___           ___           ___
//                          ╰─────────────┴─────────────┴─────────────┴─────────────╯  ╰─────────────┴─────────────┴─────────────┴─────────────╯
)


ZMK_LAYER(sys,
//            ╭─────────────┬─────────────┬─────────────┬─────────────┬─────────────╮  ╭─────────────┬─────────────┬─────────────┬─────────────┬─────────────╮
                ___           ___           ___           ___           ___              ___           ___           ___           ___           ___
//            ├─────────────┼─────────────┼─────────────┼─────────────┼─────────────┤  ├─────────────┼─────────────┼─────────────┼─────────────┼─────────────┤
                                            _BT_SEL_KEYS_                                ___           ___           ___           ___           ___
//╭─────────╮ ├─────────────┼─────────────┼─────────────┼─────────────┼─────────────┤  ├─────────────┼─────────────┼─────────────┼─────────────┼─────────────┤ ╭─────────╮
    ___         ___           ___           ___           ___           &bootloader      &bootloader   ___           ___           ___           ___             ___
//╰─────────╯ ├─────────────┼─────────────┼─────────────┼─────────────┼─────────────┤  ├─────────────┼─────────────┼─────────────┼─────────────┼─────────────┤ ╰─────────╯
                ___           ___           ___           ___           &sys_reset       &sys_reset    ___           ___           ___           ___
//            ╰─────────────┼─────────────┼─────────────┼─────────────┼─────────────┤  ├─────────────┼─────────────┼─────────────┴───────────────────────────╯
                              ___           ___           ___           ___              ___           ___           ___           ___
//                          ╰─────────────┴─────────────┴─────────────┴─────────────╯  ╰─────────────┴─────────────┴─────────────┴─────────────╯
)


ZMK_LAYER(media,
//            ╭─────────────┬─────────────┬─────────────┬─────────────┬─────────────╮  ╭─────────────┬─────────────┬─────────────┬─────────────┬─────────────╮
                ___           ___           ___           ___           ___              ___           ___           ___           ___           ___
//            ├─────────────┼─────────────┼─────────────┼─────────────┼─────────────┤  ├─────────────┼─────────────┼─────────────┼─────────────┼─────────────┤
                                            _UG_RGB_CLR_KEYS_                            ___           ___           ___           ___           ___
//╭─────────╮ ├─────────────┼─────────────┼─────────────┼─────────────┼─────────────┤  ├─────────────┼─────────────┼─────────────┼─────────────┼─────────────┤ ╭─────────╮
    &tog GAM                                _UG_RGB_UP_KEYS_                             &kp C_MUTE    &kp C_VOL_UP  &kp C_PP      &kp C_STOP    ___             ___
//╰─────────╯ ├─────────────┼─────────────┼─────────────┼─────────────┼─────────────┤  ├─────────────┼─────────────┼─────────────┼─────────────┼─────────────┤ ╰─────────╯
                                            _UG_RGB_DN_KEYS_                             ___           &kp C_VOL_DN  &kp C_PREV    &kp C_NEXT    ___
//            ╰─────────────┼─────────────┼─────────────┼─────────────┼─────────────┤  ├─────────────┼─────────────┼─────────────┴───────────────────────────╯
                              ___           ___           ___           ___              ___           ___           ___           ___
//                          ╰─────────────┴─────────────┴─────────────┴─────────────╯  ╰─────────────┴─────────────┴─────────────┴─────────────╯
)


ZMK_LAYER(game,
//            ╭─────────────┬─────────────┬─────────────┬─────────────┬─────────────╮  ╭─────────────┬─────────────┬─────────────┬─────────────┬─────────────╮
                &kp N1        &kp N2        &kp N3        &kp N4        &kp N5           ___           ___           ___           ___           ___
//            ├─────────────┼─────────────┼─────────────┼─────────────┼─────────────┤  ├─────────────┼─────────────┼─────────────┼─────────────┼─────────────┤
                &kp TAB       &kp Q         &kp W         &kp E         &kp R            ___           ___           ___           ___           ___
//╭─────────╮ ├─────────────┼─────────────┼─────────────┼─────────────┼─────────────┤  ├─────────────┼─────────────┼─────────────┼─────────────┼─────────────┤ ╭─────────╮
   &lt GAMP ESC &kp LSHFT     &kp A         &kp S         &kp D         &kp F            ___           ___           ___           ___           ___             ___
//╰─────────╯ ├─────────────┼─────────────┼─────────────┼─────────────┼─────────────┤  ├─────────────┼─────────────┼─────────────┼─────────────┼─────────────┤ ╰─────────╯
                &kp LCTRL     &kp Z         &kp X         &kp C         &kp V            ___           ___           ___           ___           ___
//            ╰─────────────┼─────────────┼─────────────┼─────────────┼─────────────┤  ├─────────────┼─────────────┼─────────────┴───────────────────────────╯
                              &kp LALT      &kp SPACE     &kp G         &kp LGUI         ___           ___           ___           ___
//                          ╰─────────────┴─────────────┴─────────────┴─────────────╯  ╰─────────────┴─────────────┴─────────────┴─────────────╯
)


ZMK_LAYER(gameplus,
//            ╭─────────────┬─────────────┬─────────────┬─────────────┬─────────────╮  ╭─────────────┬─────────────┬─────────────┬─────────────┬─────────────╮
                &kp N6        &kp N7        &kp N8        &kp N9        &kp N0           ___           ___           ___           ___           ___
//            ├─────────────┼─────────────┼─────────────┼─────────────┼─────────────┤  ├─────────────┼─────────────┼─────────────┼─────────────┼─────────────┤
                &kp TAB       ___           ___           ___           &kp T            ___           ___           ___           ___           ___
//╭─────────╮ ├─────────────┼─────────────┼─────────────┼─────────────┼─────────────┤  ├─────────────┼─────────────┼─────────────┼─────────────┼─────────────┤ ╭─────────╮
   ___          ___           &kp G         ___           ___           &kp B            ___           ___           ___           ___           ___             ___
//╰─────────╯ ├─────────────┼─────────────┼─────────────┼─────────────┼─────────────┤  ├─────────────┼─────────────┼─────────────┼─────────────┼─────────────┤ ╰─────────╯
                ___           ___           ___           ___           &kp M            ___           ___           ___           ___           ___
//            ╰─────────────┼─────────────┼─────────────┼─────────────┼─────────────┤  ├─────────────┼─────────────┼─────────────┴───────────────────────────╯
                              ___           ___           ___           &tog GAM         ___           ___           ___           ___
//                          ╰─────────────┴─────────────┴─────────────┴─────────────╯  ╰─────────────┴─────────────┴─────────────┴─────────────╯
)
