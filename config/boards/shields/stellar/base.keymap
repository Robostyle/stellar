/*
 * Keymap stellar, loosly based on:
 *   https://github.com/urob/zmk-config/blob/main/config/base.keymap
 */

#include <behaviors.dtsi>
#include <dt-bindings/zmk/keys.h>

#ifdef CONFIG_WIRELESS
    #include <dt-bindings/zmk/bt.h>
    #include <dt-bindings/zmk/outputs.h>
    #define _BT_SEL_KEYS_                                                      \
        &bt BT_SEL 0 &bt BT_SEL 1 &bt BT_SEL 2 &bt BT_SEL 3 &bt BT_SEL 4
#else
    #define _BT_SEL_KEYS_ &trans &trans &trans &trans &trans
#endif

#ifdef CONFIG_RGB_UNDERGLOW
    #include <dt-bindings/zmk/rgb.h>
    #define UG_CLR_PINK &rgb_ug RGB_COLOR_HSB(328, 100, 54)
    #define UG_CLR_RED  &rgb_ug RGB_COLOR_HSB(348, 83, 47)
    #define UG_CLR_BLUE &rgb_ug RGB_COLOR_HSB(207, 44, 49)
    #define UG_CLR_PRPL &rgb_ug RGB_COLOR_HSB(260, 49, 86)

    #define _UG_RGB_CLR_KEYS_ &rgb_ug RGB_TOG UG_CLR_PINK UG_CLR_RED UG_CLR_BLUE UG_CLR_PRPL
    #define _UG_RGB_UP_KEYS_ &rgb_ug RGB_HUI &rgb_ug RGB_SAI &rgb_ug RGB_BRI &rgb_ug RGB_SPI &rgb_ug RGB_EFF
    #define _UG_RGB_DN_KEYS_ &rgb_ug RGB_HUD &rgb_ug RGB_SAD &rgb_ug RGB_BRD &rgb_ug RGB_SPD &rgb_ug RGB_EFR
#else
    #define _UG_RGB_CLR_KEYS_ &trans &trans &trans &trans &trans
    #define _UG_RGB_UP_KEYS_ &trans &trans &trans &trans &trans
    #define _UG_RGB_DN_KEYS_ &trans &trans &trans &trans &trans
#endif

#include "zmk-helpers/helper.h"

#define DEF  0
#define NUM  1
#define MED  2
#define FN   3
#define SYS  4
#define GAM  5
#define GAMP 6

#define XXX &none
#define ___ &trans


/* Global defaults */

#define QUICK_TAP_MS 175

&sk {
    release-after-ms = <900>;
    quick-release;
};

&sl {  // Allow sticky mods to chord across sticky layers.
    ignore-modifiers;
};

&lt {
    flavor = "balanced";
    tapping-term-ms = <200>;
    quick-tap-ms = <QUICK_TAP_MS>;
};


/* Homerow mods */

// Numeric keys.
#define NUM_L  LN0 LN1 LN2 LN3 LN4
#define NUM_R  RN0 RN1 RN2 RN3 RN4
// Left/right hand keys.
#define KEYS_L LT0 LT1 LT2 LT3 LT4 LM0 LM1 LM2 LM3 LM4 LB0 LB1 LB2 LB3 LB4
#define KEYS_R RT0 RT1 RT2 RT3 RT4 RM0 RM1 RM2 RM3 RM4 RB0 RB1 RB2 RB3 RB4
// Thumb keys.
#define THUMBS LH3 LH2 LH1 LH0 RH0 RH1 RH2 RH3

#define MAKE_HRM(NAME, HOLD, TAP, TRIGGER_POS)                                 \
  ZMK_HOLD_TAP(NAME, bindings = <HOLD>, <TAP>; flavor = "balanced";            \
               tapping-term-ms = <280>; quick-tap-ms = <QUICK_TAP_MS>;         \
               require-prior-idle-ms = <150>; hold-trigger-on-release;         \
               hold-trigger-key-positions = <TRIGGER_POS>;)

MAKE_HRM(hml, &kp, &kp, NUM_R KEYS_R THUMBS)  // Left-hand HRMs.
MAKE_HRM(hmr, &kp, &kp, NUM_L KEYS_L THUMBS)  // Right-hand HRMs.

// Hack: Make HRM combos tap-only (cf, ZMK issue #544).
#define ZMK_COMBO_8(NAME, TAP, POS, LAYERS, COMBO_MS, IDLE_MS, HOLD, SIDE)     \
  MAKE_HRM(hm_combo_##NAME, &kp, TAP, SIDE THUMBS)                             \
  ZMK_COMBO_6(NAME, &hm_combo_##NAME HOLD 0, POS, LAYERS, COMBO_MS, IDLE_MS)

/* Combos, leader key sequences */

#include "combos.dtsi"  // Must be sourced after HRM-combo hack.


/* Nav cluster */

// Trigger tap-action on all interrupts.
#define MT_CORE                                                                \
    flavor = "tap-preferred";                                                  \
    tapping-term-ms = <220>;                                                   \
    quick-tap-ms = <220>;                                                      \
    hold-trigger-key-positions = <0>;

&mt { MT_CORE };


ZMK_HOLD_TAP(nav_thumb, bindings = <&mo>, <&kp>; flavor = "balanced";
    tapping-term-ms = <200>; quick-tap-ms = <200>;
)

// Define mod-morph with a *single* mod trigger for less repetition.
#define SIMPLE_MORPH(NAME, MOD, BINDING1, BINDING2)                            \
  ZMK_MOD_MORPH(NAME, mods = <(MOD_L##MOD | MOD_R##MOD)>;                      \
                bindings = <BINDING1>, <BINDING2>;)

// Hold: Lshft: Lshft | Lshft + Rshft: capslock
ZMK_MOD_MORPH(rshft_caps, 
              bindings = <&kp RSHFT>, <&caps_word>;
              mods = <(MOD_LSFT)>;
)

// Tap: comma | Shift + tap: semicolon | Ctrl + shift + tap: <.
SIMPLE_MORPH(comma_morph, SFT, &kp COMMA, &comma_inner_morph)
SIMPLE_MORPH(comma_inner_morph, CTL, &kp SEMICOLON, &kp LESS_THAN)

// Tap: dot | Shift + tap: colon | Ctrl + shift + tap: >.
SIMPLE_MORPH(dot_morph, SFT, &kp DOT, &dot_inner_morph)
SIMPLE_MORPH(dot_inner_morph, CTL, &kp COLON, &kp GREATER_THAN)

// Tap: qmark | Shift + tap: excl.
SIMPLE_MORPH(qexcl, SFT, &kp QMARK, &kp EXCL)

// Tap: left/right parenthesis | Shft + tap: less-than/greater-than.
SIMPLE_MORPH(lpar_lt, SFT, &kp LPAR, &kp LT)
SIMPLE_MORPH(rpar_gt, SFT, &kp RPAR, &kp GT)

/* Custom behaviors */

#define CTRL_DEL &kp LC(DEL)

// Tap: backspace | Lshft + tap: delete | Rshft + tap: ctrl-delete.
ZMK_MOD_MORPH(bs_del_right,
    bindings = <&kp BSPC>, <CTRL_DEL>;
    mods = <(MOD_RSFT)>;
)

// 3. The Outer Morph: Handles the Left Shift logic and links to the inner morph
ZMK_MOD_MORPH(bs_del,
    bindings = <&bs_del_right>, <&kp DEL>;
    mods = <(MOD_LSFT)>;
)

// Misc aliases.
#define PAUSEBREAK      &kp PAUSE_BREAK
#define NAV_SPACE       &nav_thumb NUM SPACE
#define NAV_RET         &nav_thumb NUM RET
#define FN_DEL          &lt FN DEL

/* Keymap */

#ifndef ZMK_BASE_LAYER
  #define ZMK_BASE_LAYER(name, LN, RN, LT, RT, LM, RM, LB, RB, LH, RH)        \
      ZMK_LAYER(name, LN RN LT RT LM RM LB RB LH RH)
#endif

ZMK_BASE_LAYER(Base,
//            ╭─────────────┬─────────────┬─────────────┬─────────────┬─────────────╮  ╭─────────────┬─────────────┬─────────────┬─────────────┬─────────────╮
                &kp N1        &kp N2        &kp N3        &kp N4        &kp N5      ,    &kp N6        &kp N7        &kp N8        &kp N9        &kp N0      ,
//            ├─────────────┼─────────────┼─────────────┼─────────────┼─────────────┤  ├─────────────┼─────────────┼─────────────┼─────────────┼─────────────┤
                &kp Q         &kp W         &kp E         &kp R         &kp T       ,    &kp Y         &kp U         &kp I         &kp O         &kp P       ,
//╭─────────╮ ├─────────────┼─────────────┼─────────────┼─────────────┼─────────────┤  ├─────────────┼─────────────┼─────────────┼─────────────┼─────────────┤ ╭─────────╮
    &kp ESC     &hml LGUI A   &hml LALT S   &kp D         &hml LCTRL F  &kp G       ,    &kp H         &hmr LCTRL J  &kp K         &hmr LALT L   &hmr LGUI SEMI  &bs_del ,
//╰─────────╯ ├─────────────┼─────────────┼─────────────┼─────────────┼─────────────┤  ├─────────────┼─────────────┼─────────────┼─────────────┼─────────────┤ ╰─────────╯
                &kp Z         &kp X         &kp C         &kp V         &kp B       ,    &kp N         &kp M         &kp COMMA     &kp DOT       &kp SLASH   ,
//            ╰─────────────┼─────────────┼─────────────┼─────────────┼─────────────┤  ├─────────────┼─────────────┼─────────────┴───────────────────────────╯
                              &kp LSHFT     NAV_SPACE     FN_DEL        &mo MED     ,    &mo SYS       &kp TAB       NAV_RET       &rshft_caps
//                          ╰─────────────┴─────────────┴─────────────┴─────────────╯  ╰─────────────┴─────────────┴─────────────┴─────────────╯
)


ZMK_BASE_LAYER(Num,
//            ╭─────────────┬─────────────┬─────────────┬─────────────┬─────────────╮  ╭─────────────┬─────────────┬─────────────┬─────────────┬─────────────╮
                ___           ___           ___           ___           ___         ,    ___           ___           ___           ___           ___         ,
//            ├─────────────┼─────────────┼─────────────┼─────────────┼─────────────┤  ├─────────────┼─────────────┼─────────────┼─────────────┼─────────────┤
                ___           &kp N7        &kp N8        &kp N9        ___         ,    &kp HOME      &kp PG_DN     &kp PG_UP     &kp END       ___         ,
//╭─────────╮ ├─────────────┼─────────────┼─────────────┼─────────────┼─────────────┤  ├─────────────┼─────────────┼─────────────┼─────────────┼─────────────┤ ╭─────────╮
    ___         &kp N0        &hml LALT N4  &kp N5        &hml LCTRL N6 ___         ,    &kp LEFT      &kp DOWN      &kp UP        &kp RIGHT     &kp INS         ___     ,
//╰─────────╯ ├─────────────┼─────────────┼─────────────┼─────────────┼─────────────┤  ├─────────────┼─────────────┼─────────────┼─────────────┼─────────────┤ ╰─────────╯
                ___           &kp N1        &kp N2        &kp N3        ___         ,    ___           ___           ___           ___           ___         ,
//            ╰─────────────┼─────────────┼─────────────┼─────────────┼─────────────┤  ├─────────────┼─────────────┼─────────────┴───────────────────────────╯
                              ___           ___           ___           ___         ,    ___           ___           ___           ___
//                          ╰─────────────┴─────────────┴─────────────┴─────────────╯  ╰─────────────┴─────────────┴─────────────┴─────────────╯
)


ZMK_BASE_LAYER(Media,
//            ╭─────────────┬─────────────┬─────────────┬─────────────┬─────────────╮  ╭─────────────┬─────────────┬─────────────┬─────────────┬─────────────╮
                                            _BT_SEL_KEYS_                           ,    &bt BT_CLR    ___           ___           &bt BT_PRV    &bt BT_NXT  ,
//            ├─────────────┼─────────────┼─────────────┼─────────────┼─────────────┤  ├─────────────┼─────────────┼─────────────┼─────────────┼─────────────┤
                                            _UG_RGB_CLR_KEYS_                       ,    ___           ___           ___           ___           &out OUT_USB,
//╭─────────╮ ├─────────────┼─────────────┼─────────────┼─────────────┼─────────────┤  ├─────────────┼─────────────┼─────────────┼─────────────┼─────────────┤ ╭─────────╮
    &kp PSCRN                               _UG_RGB_UP_KEYS_                        ,    &kp C_MUTE    &kp C_VOL_UP  &kp C_PP      ___           &out OUT_BLE    &out OUT_TOG,
//╰─────────╯ ├─────────────┼─────────────┼─────────────┼─────────────┼─────────────┤  ├─────────────┼─────────────┼─────────────┼─────────────┼─────────────┤ ╰─────────╯
                                            _UG_RGB_DN_KEYS_                        ,    ___           &kp C_VOL_DN  &kp C_PREV    &kp C_NEXT    ___         ,
//            ╰─────────────┼─────────────┼─────────────┼─────────────┼─────────────┤  ├─────────────┼─────────────┼─────────────┴───────────────────────────╯
                              ___           ___           ___           ___         ,    &tog GAM     ___            ___           ___
//                          ╰─────────────┴─────────────┴─────────────┴─────────────╯  ╰─────────────┴─────────────┴─────────────┴─────────────╯
)


ZMK_BASE_LAYER(Fn,
//            ╭─────────────┬─────────────┬─────────────┬─────────────┬─────────────╮  ╭─────────────┬─────────────┬─────────────┬─────────────┬─────────────╮
                &kp F1        &kp F2        &kp F3        &kp F4        &kp F5      ,    &kp F6        &kp F7        &kp F8        &kp F9        &kp F10     ,
//            ├─────────────┼─────────────┼─────────────┼─────────────┼─────────────┤  ├─────────────┼─────────────┼─────────────┼─────────────┼─────────────┤
                &kp F11       &kp F12       &kp F13       &kp F14       &kp F15     ,    &kp F16       &kp F17       &kp F18       &kp F19       &kp F20     ,
//╭─────────╮ ├─────────────┼─────────────┼─────────────┼─────────────┼─────────────┤  ├─────────────┼─────────────┼─────────────┼─────────────┼─────────────┤ ╭─────────╮
   ___          ___           ___           ___           &kp SLCK      PAUSEBREAK  ,    &kp C_PWR     &kp C_AL_CALC ___           ___           ___             ___     ,
//╰─────────╯ ├─────────────┼─────────────┼─────────────┼─────────────┼─────────────┤  ├─────────────┼─────────────┼─────────────┼─────────────┼─────────────┤ ╰─────────╯
                ___           ___           ___           &kp CAPS      &kp SYSREQ  ,    ___           ___           ___           ___           ___         ,
//            ╰─────────────┼─────────────┼─────────────┼─────────────┼─────────────┤  ├─────────────┼─────────────┼─────────────┴───────────────────────────╯
                              ___           ___           ___           ___         ,    ___           ___           ___           ___
//                          ╰─────────────┴─────────────┴─────────────┴─────────────╯  ╰─────────────┴─────────────┴─────────────┴─────────────╯
)


ZMK_BASE_LAYER(Sys,
//            ╭─────────────┬─────────────┬─────────────┬─────────────┬─────────────╮  ╭─────────────┬─────────────┬─────────────┬─────────────┬─────────────╮
                ___           ___           ___           ___           ___         ,    ___           ___           ___           ___           ___         ,
//            ├─────────────┼─────────────┼─────────────┼─────────────┼─────────────┤  ├─────────────┼─────────────┼─────────────┼─────────────┼─────────────┤
                ___           ___           ___           ___           ___         ,    ___           ___           ___           ___           ___         ,
//╭─────────╮ ├─────────────┼─────────────┼─────────────┼─────────────┼─────────────┤  ├─────────────┼─────────────┼─────────────┼─────────────┼─────────────┤ ╭─────────╮
    &soft_off   ___           ___           ___           ___           &bootloader ,    &bootloader   ___           ___           ___           ___             ___     ,
//╰─────────╯ ├─────────────┼─────────────┼─────────────┼─────────────┼─────────────┤  ├─────────────┼─────────────┼─────────────┼─────────────┼─────────────┤ ╰─────────╯
                ___           ___           ___           ___           &sys_reset  ,    &sys_reset    ___           ___           ___           ___         ,
//            ╰─────────────┼─────────────┼─────────────┼─────────────┼─────────────┤  ├─────────────┼─────────────┼─────────────┴───────────────────────────╯
                              ___           ___           ___           ___         ,    ___           ___           ___           ___
//                          ╰─────────────┴─────────────┴─────────────┴─────────────╯  ╰─────────────┴─────────────┴─────────────┴─────────────╯
)


ZMK_BASE_LAYER(Game,
//            ╭─────────────┬─────────────┬─────────────┬─────────────┬─────────────╮  ╭─────────────┬─────────────┬─────────────┬─────────────┬─────────────╮
                &kp GRAVE     &kp N1        &kp N2        &kp N3        &kp N4      ,    &kp N5        &kp N6        &kp N7        &kp N8        &kp N9      ,
//            ├─────────────┼─────────────┼─────────────┼─────────────┼─────────────┤  ├─────────────┼─────────────┼─────────────┼─────────────┼─────────────┤
                &kp TAB       &kp Q         &kp W         &kp E         &kp R       ,    &kp Y         &kp U         &kp I         &kp O         &kp P       ,
//╭─────────╮ ├─────────────┼─────────────┼─────────────┼─────────────┼─────────────┤  ├─────────────┼─────────────┼─────────────┼─────────────┼─────────────┤ ╭─────────╮
    ___         &kp LSHFT     &kp A         &kp S         &kp D         &kp F       ,    &kp H         &kp J         &kp K         &kp L         &kp SEMI        &kp RET ,
//╰─────────╯ ├─────────────┼─────────────┼─────────────┼─────────────┼─────────────┤  ├─────────────┼─────────────┼─────────────┼─────────────┼─────────────┤ ╰─────────╯
                &kp LALT      &kp Z         &kp X         &kp C         &kp V       ,    &kp N         &kp M         &kp COMMA     &kp DOT       &kp SLASH   ,
//            ╰─────────────┼─────────────┼─────────────┼─────────────┼─────────────┤  ├─────────────┼─────────────┼─────────────┴───────────────────────────╯
                              &kp SPACE     &kp LCTRL     &mo GAMP      ___         ,    &tog GAMP     &kp LGUI      &kp LBKT      &kp RBKT
//                          ╰─────────────┴─────────────┴─────────────┴─────────────╯  ╰─────────────┴─────────────┴─────────────┴─────────────╯
)


ZMK_BASE_LAYER(GamePlus,
//            ╭─────────────┬─────────────┬─────────────┬─────────────┬─────────────╮  ╭─────────────┬─────────────┬─────────────┬─────────────┬─────────────╮
                &kp N1        &kp N2        &kp N3        &kp N4        &kp N5      ,    &kp N6        &kp N7        &kp N8        &kp N9        &kp N0      ,
//            ├─────────────┼─────────────┼─────────────┼─────────────┼─────────────┤  ├─────────────┼─────────────┼─────────────┼─────────────┼─────────────┤
                &kp Q         &kp W         &kp E         &kp R         &kp T       ,    &kp Y         &kp U         &kp I         &kp O         &kp P       ,
//╭─────────╮ ├─────────────┼─────────────┼─────────────┼─────────────┼─────────────┤  ├─────────────┼─────────────┼─────────────┼─────────────┼─────────────┤ ╭─────────╮
    &kp ESC     &kp A         &kp S         &kp D         &kp F         &kp G       ,    &kp H         &kp J         &kp K         &kp L         &kp SEMI        &kp BSPC,
//╰─────────╯ ├─────────────┼─────────────┼─────────────┼─────────────┼─────────────┤  ├─────────────┼─────────────┼─────────────┼─────────────┼─────────────┤ ╰─────────╯
                &kp Z         &kp X         &kp C         &kp V         &kp B       ,    &kp N         &kp M         &kp COMMA     &kp DOT       &kp SLASH   ,
//            ╰─────────────┼─────────────┼─────────────┼─────────────┼─────────────┤  ├─────────────┼─────────────┼─────────────┴───────────────────────────╯
                              &kp LSHFT     &kp TAB       &kp LCTRL     ___         ,    &to DEF      &kp RET       &kp SPACE     &kp RSHFT
//                          ╰─────────────┴─────────────┴─────────────┴─────────────╯  ╰─────────────┴─────────────┴─────────────┴─────────────╯
)


/* vim: set ft=c tw=146: */
