## config/boards/shields/stellar/Kconfig.shield
```kconfig
# Copyright (c) 2022 The ZMK Contributors
# SPDX-License-Identifier: MIT

config SHIELD_STELLAR_LEFT
    def_bool $(shields_list_contains,stellar_left)

config SHIELD_STELLAR_RIGHT
    def_bool $(shields_list_contains,stellar_right)
```

## config/west.yml
```yaml
# This file specifies the build dependencies for Github Action workflows and
# for local build environments. The workspace has four toplevel directories
# containing the user config, modules, zephy and ZMK.
#
# ZMK-Workspace
# ├── config
# ├── modules
# ├── zephyr
# └── zmk
#
# To create a local build environment, clone this repository and then run the
# following commands from its toplevel directory:
#
# $ west init -l config
# $ west update
# $ west zephyr-export
#
---
manifest:
  defaults:
    remote: urob
    revision: main

  remotes:
    - name: urob
      url-base: https://github.com/urob
    - name: zmkfirmware
      url-base: https://github.com/zmkfirmware

  projects:
    - name: zmk
      remote: zmkfirmware
      import: app/west.yml

    # ZMK modules
    - name: zmk-adaptive-key
      path: modules/zmk/adaptive-key
    - name: zmk-auto-layer
      path: modules/zmk/auto-layer
    - name: zmk-helpers
      path: modules/zmk/helpers

    # Temporarily overload Zephyr until
    # https://github.com/zmkfirmware/zephyr/pull/40 is merged.
    - name: zephyr
      remote: zmkfirmware
      revision: v4.1.0+zmk-fixes
      clone-depth: 1
      import:
        name-allowlist:
          - cmsis
          - hal_nordic
          - mbedtls
          - tinycrypt

  self:
    path: config
```

## firmware/zmk/config/boards/shields/stellar/Kconfig.defconfig
```kconfig
if SHIELD_STELLAR_LEFT

config ZMK_KEYBOARD_NAME
    default "Stellar"

config ZMK_SPLIT_ROLE_CENTRAL
    default y

endif

if SHIELD_STELLAR_LEFT || SHIELD_STELLAR_RIGHT

config ZMK_SPLIT
    default y

endif
```

## firmware/zmk/config/west.yml
```yaml
# ZMK-Workspace
# ├── config
# ├── modules (user modules)
# └── zmk
#     └── modules (Zephyr modules)
#
# To create a local build environment, clone this repository and then run the
# following commands from its toplevel directory:
#
# $ west init -l config
# $ west update
# $ west zephyr-export
#
---
manifest:
  remotes:
    - name: upstream
      url-base: https://github.com/zmkfirmware

  projects:
    # ZMK with Zephyr namespaced under /zmk. This requires that ZMK imports
    # Zephyr with a path other than `zephyr` (as in `going-modular`).
    - name: zmk
      path: .
      import:
        file: app/west.yml
        path-prefix: zmk

  self:
    path: config
```
